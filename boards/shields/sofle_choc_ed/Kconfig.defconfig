## boards/shields/sofle_choc_ed/Kconfig.defconfig
```kconfig
if SHIELD_SOFLE_CHOC_ED_LEFT

config ZMK_KEYBOARD_NAME
    default "sofle_choc_ed"

config ZMK_SPLIT_ROLE_CENTRAL
    default y

endif # SHIELD_SOFLE_CHOC_ED_LEFT

if SHIELD_SOFLE_CHOC_ED_LEFT || SHIELD_SOFLE_CHOC_ED_RIGHT

config ZMK_SPLIT
    default y

endif # SHIELD_SOFLE_CHOC_ED_LEFT || SHIELD_SOFLE_CHOC_ED_RIGHT
```

## boards/shields/sofle_choc_ed/Kconfig.shield
```kconfig
config SHIELD_SOFLE_CHOC_ED_LEFT
    def_bool $(shields_list_contains,sofle_choc_ed_left)

config SHIELD_SOFLE_CHOC_ED_RIGHT
    def_bool $(shields_list_contains,sofle_choc_ed_right)
```
